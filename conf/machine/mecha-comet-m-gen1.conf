## conf/machine/mecha-comet-m-gen1.conf
```bitbake
# from meta-freescale/conf
require conf/machine/imx8mm-lpddr4-evk.conf

MACHINEOVERRIDES_EXTENDER:mx8mm:use-nxp-bsp  = "imx-generic-bsp:imx-nxp-bsp:imxdrm:imxvpu:etnaviv:mx8-generic-bsp:mx8-nxp-bsp:mx8m-generic-bsp:mx8m-nxp-bsp:mx8mm-generic-bsp:mx8mm-nxp-bsp"

APPEND += "printk.time=y initcall_debug debug"
```
