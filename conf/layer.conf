## conf/layer.conf
```bitbake
# We have a conf and classes directory, add to BBPATH
BBPATH .= ":${LAYERDIR}"

# We have recipes-* directories, add to BBFILES
BBFILES += "${LAYERDIR}/recipes-*/*/*.bb \
            ${LAYERDIR}/recipes-*/*/*.bbappend"

BBFILE_COLLECTIONS += "meta-mecha-imx"
BBFILE_PATTERN_meta-mecha-imx = "^${LAYERDIR}/"
BBFILE_PRIORITY_meta-mecha-imx = "6"

LAYERDEPENDS_meta-mecha-imx = "core"
LAYERSERIES_COMPAT_meta-mecha-imx = "scarthgap"

IMX_USE_LINUX_FIRMWARE_SDMA = "0"

### Mecha DDR SIZE configuration ###
# DDRSIZE = "4gb" for 4GB DRAM board #
# DDRSIZE = "8gb" for 8GB DRAM board #
####################################
DDRSIZE = "8gb"

MACHINE_HAS_VIVANTE_KERNEL_DRIVER_SUPPORT = "1"
MACHINE_USES_VIVANTE_KERNEL_DRIVER_MODULE = "0"

KERNEL_DEVICETREE:append:use-nxp-bsp = " freescale/imx8mp-mecha-comet-m-gen6.dtb"

MACHINE_EXTRA_RRECOMMENDS:append:imx8mp-lpddr4-evk = " kernel-modules"

DISTRO_FEATURES:append = " pulseaudio"

IMAGE_INSTALL:append = " stress-ng nxp-wlan-sdk packagegroup-qt6-imx iw i2c-tools v4l-utils alsa-state alsa-tools alsa-utils firmware-nxp-wifi-nxpiw612-sdio nxp-wlan-sdk kernel-module-nxp-wlan evtest packagegroup-fsl-isp packagegroup-core-base-utils kernel-modules isp-imx obexftp bluez5 glmark2 iperf2 iperf3 packagegroup-fsl-gstreamer1.0-commercial pulseaudio pulseaudio pulseaudio-server curl bluez-tools blueman pipewire-media-session pipewire modemmanager "

CORE_IMAGE_EXTRA_INSTALL += " bluealsa alsa-utils curl obexftp bluez5 bluez-tools blueman pipewire-media-session ofono sox packagegroup-tools-bluetooth openobex hidapi liblc3 "
```
